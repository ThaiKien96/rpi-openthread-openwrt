## simulator-defconfig
```kconfig
CONFIG_TARGET_x86=y
CONFIG_TARGET_x86_legacy=y
CONFIG_TARGET_x86_legacy_DEVICE_generic=y
CONFIG_HAS_SUBTARGETS=y
CONFIG_HAS_DEVICES=y
CONFIG_TARGET_BOARD="x86"
CONFIG_TARGET_SUBTARGET="legacy"
CONFIG_TARGET_PROFILE="DEVICE_generic"
CONFIG_TARGET_ARCH_PACKAGES="i386_pentium-mmx"
CONFIG_DEFAULT_TARGET_OPTIMIZATION="-Os -pipe -march=pentium-mmx"
CONFIG_CPU_TYPE="pentium-mmx"
CONFIG_LINUX_5_4=y
CONFIG_i386=y
CONFIG_ARCH="i386"
CONFIG_VMDK_IMAGES=y
CONFIG_ISO_IMAGES=y
# CONFIG_TARGET_IMAGES_GZIP is not set
# CONFIG_TARGET_ROOTFS_EXT4FS is not set
# CONFIG_GRUB_IMAGES is not set
CONFIG_TARGET_KERNEL_PARTSIZE=16
CONFIG_TARGET_ROOTFS_PARTSIZE=104
CONFIG_TARGET_ROOTFS_PARTNAME=""
CONFIG_PACKAGE_kmod-usb-uhci=y

CONFIG_PACKAGE_devinfo=y
```
